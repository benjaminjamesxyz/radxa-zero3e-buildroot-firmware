## buildroot/configs/radxa_zero3e_defconfig
```kconfig
BR2_aarch64=y
BR2_cortex_a55=y
BR2_PACKAGE_HOST_LINUX_HEADERS_CUSTOM_6_18=y
BR2_TOOLCHAIN_BUILDROOT_CXX=y
BR2_TARGET_GENERIC_ROOT_PASSWD="root"
BR2_ROOTFS_USERS_TABLES="board/radxa/radxa_zero3e/users.txt"
BR2_ROOTFS_OVERLAY="board/radxa/radxa_zero3e/rootfs_overlay"
BR2_ROOTFS_POST_BUILD_SCRIPT="board/radxa/radxa_zero3e/post-build.sh"
BR2_ROOTFS_POST_IMAGE_SCRIPT="support/scripts/genimage.sh board/radxa/radxa_zero3e/compress-image.sh"
BR2_ROOTFS_POST_SCRIPT_ARGS="-c board/radxa/radxa_zero3e/genimage-radxa-zero3e.cfg"
BR2_LINUX_KERNEL=y
BR2_LINUX_KERNEL_CUSTOM_VERSION=y
BR2_LINUX_KERNEL_CUSTOM_VERSION_VALUE="6.18.3"
BR2_LINUX_KERNEL_USE_CUSTOM_CONFIG=y
BR2_LINUX_KERNEL_CUSTOM_CONFIG_FILE="board/radxa/radxa_zero3e/kernel.config"
BR2_LINUX_KERNEL_DTS_SUPPORT=y
BR2_LINUX_KERNEL_INTREE_DTS_NAME="rockchip/rk3566-radxa-zero-3e"
BR2_LINUX_KERNEL_DTB_KEEP_DIRNAME=y
BR2_LINUX_KERNEL_INSTALL_TARGET=y
BR2_PACKAGE_DEV_TOOLS_BUNDLE=y
BR2_PACKAGE_ROCKCHIP_RKBIN=y
BR2_PACKAGE_ROCKCHIP_RKBIN_TPL_FILENAME="bin/rk35/rk3566_ddr_1056MHz_v1.18.bin"
BR2_PACKAGE_PYTHON3=y
BR2_PACKAGE_TOILET=y
BR2_PACKAGE_HELLOWORLD_C=y
BR2_PACKAGE_HELLOWORLD_CPP=y
BR2_PACKAGE_HELLOWORLD_GO=y
BR2_PACKAGE_HELLOWORLD_PYTHON=y
BR2_PACKAGE_HELLOWORLD_RUST=y
BR2_TARGET_ROOTFS_EXT2=y
BR2_TARGET_ROOTFS_EXT2_4=y
BR2_TARGET_ROOTFS_EXT2_SIZE="250M"
BR2_TARGET_ARM_TRUSTED_FIRMWARE=y
BR2_TARGET_ARM_TRUSTED_FIRMWARE_CUSTOM_VERSION=y
BR2_TARGET_ARM_TRUSTED_FIRMWARE_CUSTOM_VERSION_VALUE="v2.12"
BR2_TARGET_ARM_TRUSTED_FIRMWARE_PLATFORM="rk3568"
BR2_TARGET_ARM_TRUSTED_FIRMWARE_IMAGES="bl31/bl31.elf"
BR2_TARGET_UBOOT=y
BR2_TARGET_UBOOT_BUILD_SYSTEM_KCONFIG=y
BR2_TARGET_UBOOT_CUSTOM_VERSION=y
BR2_TARGET_UBOOT_CUSTOM_VERSION_VALUE="2025.10"
BR2_TARGET_UBOOT_BOARD_DEFCONFIG="radxa-zero-3-rk3566"
BR2_TARGET_UBOOT_CONFIG_FRAGMENT_FILES="board/radxa/radxa_zero3e/uboot-fragment.config"
BR2_TARGET_UBOOT_NEEDS_PYLIBFDT=y
BR2_TARGET_UBOOT_NEEDS_PYELFTOOLS=y
BR2_TARGET_UBOOT_NEEDS_OPENSSL=y
BR2_TARGET_UBOOT_NEEDS_GNUTLS=y
BR2_TARGET_UBOOT_NEEDS_ATF_BL31=y
BR2_TARGET_UBOOT_NEEDS_ATF_BL31_ELF=y
BR2_TARGET_UBOOT_NEEDS_ROCKCHIP_RKBIN=y
BR2_PACKAGE_HOST_GENIMAGE=y
BR2_PACKAGE_HOST_GO=y
BR2_PACKAGE_HOST_RUSTC=y
BR2_PACKAGE_HOST_UBOOT_TOOLS=y
```

## buildroot/package/dev_tools_bundle/Config.in
```kconfig
config BR2_PACKAGE_DEV_TOOLS_BUNDLE
	bool "dev-tools-bundle"
	select BR2_PACKAGE_GDB
	select BR2_PACKAGE_GDB_SERVER
	select BR2_PACKAGE_GDB_DEBUGGER
	select BR2_PACKAGE_STRACE
	select BR2_PACKAGE_VALGRIND if BR2_PACKAGE_VALGRIND_ARCH_SUPPORTS
	select BR2_PACKAGE_LINUX_TOOLS
	select BR2_PACKAGE_LINUX_TOOLS_PERF
	select BR2_PACKAGE_HTOP
	select BR2_PACKAGE_MEMSTAT
	select BR2_PACKAGE_LTTNG_TOOLS if !BR2_PACKAGE_PYTHON3
	select BR2_PACKAGE_LTTNG_LIBUST if !BR2_PACKAGE_PYTHON3
	select BR2_PACKAGE_LIBURCU
	select BR2_TOOLCHAIN_HAS_THREADS
	select BR2_TOOLCHAIN_HAS_THREADS_DEBUG
	select BR2_PACKAGE_GDB_ARCH_SUPPORTS
	select BR2_TOOLCHAIN_GCC_AT_LEAST_4_8
	select BR2_INSTALL_LIBSTDCPP
	help
	  Enables a suite of development and debugging tools including:
	  - GDB (Server and Debugger)
	  - Strace
	  - Valgrind (Memory Analysis)
	  - Perf (Linux Tools)
	  - Htop
	  - Memstat
	  - LTTng (userspace tracing)
```

## buildroot/package/helloworld_c/Config.in
```kconfig
config BR2_PACKAGE_HELLOWORLD_C
	bool "helloworld_c"
	help
	  A simple C hello world program.
```

## buildroot/package/helloworld_cpp/Config.in
```kconfig
config BR2_PACKAGE_HELLOWORLD_CPP
	bool "helloworld_cpp"
	help
	  A simple C++ hello world program.
```

## buildroot/package/helloworld_go/Config.in
```kconfig
config BR2_PACKAGE_HELLOWORLD_GO
	bool "helloworld_go"
	help
	  A simple go hello world program.
```

## buildroot/package/helloworld_python/Config.in
```kconfig
config BR2_PACKAGE_HELLOWORLD_PYTHON
	bool "helloworld_python"
	help
	  A simple python hello world program.
```

## buildroot/package/helloworld_rust/Config.in
```kconfig
config BR2_PACKAGE_HELLOWORLD_RUST
	bool "helloworld_rust"
	help
	  A simple Rust hello world program.
```

## buildroot/package/libcaca/Config.in
```kconfig
config BR2_PACKAGE_LIBCACA
	bool "libcaca"
	depends on BR2_USE_WCHAR # libcaca uses wide characters
	select BR2_PACKAGE_NCURSES # For terminal output
	help
	  Colour ASCII Art library.

	  http://caca.zoy.org/wiki/libcaca
```

## buildroot/package/toilet/Config.in
```kconfig
config BR2_PACKAGE_TOILET
	bool "toilet"
	select BR2_PACKAGE_LIBCACA # toilet depends on libcaca
	help
	  TOIlet (The Other Implementation's Letters) is a free replacement
	  for FIGlet. It prints text using large characters made of smaller
	  characters.

	  http://caca.zoy.org/wiki/toilet
```

## buildroot/package/wol/Config.in
```kconfig
config BR2_PACKAGE_WOL
	bool "wol"
	help
	  A small utility to send Wake-On-LAN packets.
```
